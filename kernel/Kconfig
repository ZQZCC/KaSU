## kernel/Kconfig
```kconfig
menu "KernelSU"

config KSU
	bool "KaSU TinyFS support"
	depends on ARM64 && !CPU_BIG_ENDIAN
	depends on SECURITY_SELINUX
	select SECCOMP
	default y
	help
	  Enable kernel-level root privileges on Android System.

config KSU_TINYFS_SUCOMPAT
	bool
	depends on KSU = y
	depends on ARM64
	default y
	help
	  Expose a synthetic /system/bin/su entry backed by a tiny ARM64
	  launcher. This targets fixed ARM64 6.1 built-in kernels and is not a
	  generic LKM compatibility layer.

config KSU_TINYFS_NO_SETUID
	bool
	depends on KSU_TINYFS_SUCOMPAT
	default y
	help
	  For fixed TinyFS/NoMount kernels with manual security hooks only.
	  Obtain control FDs on demand and clear seccomp only when granting root.
	  NoMount must provide module visibility rules; KernelSU's module-unmount
	  policy is unavailable. There is no traditional sucompat fallback if
	  TinyFS initialization fails.

config KSU_TINYFS_PKG_OBSERVER
	bool
	depends on KSU_TINYFS_NO_SETUID
	depends on KSU_THRONE_TRACKER_ALWAYS_THREADED
	default y
	help
	  For fixed built-in Linux 6.1 TinyFS/NoMount kernels only. Replace the
	  global manual rename observer with /data/system's inode rename callback.
	  This observes successful same-directory packages.list replacements.
	  The directory must remain in place for the lifetime of the kernel;
	  cross-directory imports and replacing or overlaying /data/system are
	  not supported. Initialization is retried at boot completion.

config KSU_USERSPACE_POLICY
	bool "Persist TinyFS app profiles in ksud"
	depends on KSU_TINYFS_NO_SETUID
	default n
	help
	  Experimental policy storage for fixed built-in TinyFS kernels.
	  ksud restores profiles before post-fs-data and an init-managed service
	  saves versioned snapshots on policy changes. Requires matching ksud.
	  Manager authorization and the ordinary su path remain unchanged.

config KSU_FEATURE_SULOG
	bool "KernelSU SU Logging feature"
	depends on KSU
	default y
	help
	  Build KernelSU's SU Log.

config KSU_THRONE_TRACKER_ALWAYS_THREADED
	bool
	depends on KSU
	default y
	help
	  Enable this option to run throne tracker in a kthread for the first
	  run, which happens at boot time / decryption stage. This can decrease
	  boot time, but can cause crowning failure on some FDE/FBEv1 setups.
	  If unsure, say n.

config KSU_NOPRINTK
	bool "disable ALL dmesg logging"
	depends on KSU
	depends on !KSU_DEBUG
	default n
	help
	  Disable KernelSU dmesg output.

config KSU_SHELL_HAS_SU_ALWAYS
	bool "give shell su"
	depends on KSU
	default n
	help
	  Always allow shell (2000) for su. Can speedup sucompat gate as a side-effect.

config KSU_DEBUG
	bool "KernelSU debug mode"
	depends on KSU
	default n
	help
	  Enable KernelSU debug mode.

endmenu
```
